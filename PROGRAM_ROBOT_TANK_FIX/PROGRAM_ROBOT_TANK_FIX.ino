#include <SPI.h>
#include <Wire.h>
#include <Adafruit_GFX.h>
#include <Adafruit_SSD1306.h>
#include <RTClib.h>
#include <SD.h>

#define SCREEN_WIDTH 128 // OLED width,  in pixels
#define SCREEN_HEIGHT 64 // OLED height, in pixels
Adafruit_SSD1306 oled(SCREEN_WIDTH, SCREEN_HEIGHT, &Wire, -1);

#define LS 4
#define pinRelay1 32
#define pinRelay2 33
byte IN1 = 26; //motor1 INA
byte IN2 = 27; //motor1 INAB
byte IN3 = 17; //motor2 INA
byte IN4 = 16; //motor2 INAB

byte trigPin1 = 12;
byte echoPin1 = 34;
byte trigPin2 = 13;
byte echoPin2 = 36;
byte trigPin3 = 14;
byte echoPin3 = 39;
bool kondisi;
#define kecepatanSuara 0.034

const int pwm = 175;

float jarakcm1, jarakcm2, jarakcm3;

RTC_DS3231 rtc;
int tahun, bulan, hari, jam, menit, detik;

File dataFile; // Objek file untuk menyimpan data


static const unsigned char PROGMEM image_data_ARDUINOarray[] = {
  // ARDUINO Logo C-File Array
  0x00, 0x00, 0x00, 0x00, 0x00, 0x00, 0x00, 0x00, 0x00, 0x00, 0x00, 0x00, 0x00, 0x00, 0x00, 0x00,
  0x00, 0x00, 0x00, 0x00, 0x00, 0x00, 0x00, 0x00, 0x00, 0x00, 0x00, 0x00, 0x00, 0x00, 0x00, 0x00,
  0x00, 0x00, 0x00, 0x00, 0x00, 0x00, 0x00, 0x00, 0x00, 0x00, 0x00, 0x00, 0x00, 0x00, 0x00, 0x00,
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  0x00, 0x00, 0x00, 0x00, 0x00, 0x00, 0x00, 0x00, 0x00, 0x00, 0x00, 0x00, 0x00, 0x00, 0x00, 0x00,
};

void team() {
  if (!oled.begin(SSD1306_SWITCHCAPVCC, 0x3C)) {
    Serial.println(F("failed to start SSD1306 OLED"));
    while (1);
  }
  delay(1000);         // wait two seconds for initializing
  oled.clearDisplay();  // Clear the buffer
  oled.drawBitmap(0, 0, image_data_ARDUINOarray, 128, 64, 1);
  oled.display();
  delay(1000);
  oled.clearDisplay(); // clear oled.
  oled.setTextSize(3);         // set text size
  oled.setTextColor(WHITE);    // set text color
  oled.setCursor(30, 10);       // set position to oled. (x,y)
  oled.println("Al-");// set text
  oled.display();
  oled.setCursor(20, 35);       // set position to oled. (x,y)
  oled.println("HAMAS");// set text
  oled.display();
  delay(2000);
  oled.clearDisplay(); // clear oled.
  oled.setTextSize(2);         // set text size
  oled.setCursor(30, 0);
  oled.println("ARIEF RA");
  oled.setCursor(30, 25);
  oled.println("NIKE RA");
  oled.display();           // oled. on OLED
  oled.setCursor(30, 50);
  oled.println("NIZAM RA");
  oled.display();
  delay(1000);         // wait two seconds for initializing
  oled.clearDisplay();
  oled.display();

  if (!rtc.begin()) {
    Serial.println("Couldn't find RTC");
    Serial.flush();
    while (1) delay(10);
  }

  if (rtc.lostPower()) {
    rtc.adjust(DateTime(F(__DATE__), F(__TIME__)));
  }

  if (!SD.begin(5)) { // Ganti dengan pin chip select yang sesuai
    Serial.println("Gagal inisialisasi kartu microSD.");
    while (1);
  }
}
void maju_oled() {
  oled.clearDisplay();
  oled.setTextSize(2);
  oled.setTextColor(WHITE);
  oled.setCursor(20, 20);
  oled.println("MAJU BOZZ");
  oled.display();
  analogWrite(IN1, pwm); //motor1 A
  analogWrite(IN2, 0); //motor1 B
  analogWrite(IN3, pwm); //motor2 A
  analogWrite(IN4, 0); //motor2 B
}
void kiri_oled() {
  oled.clearDisplay();
  oled.setTextSize(2);
  oled.setTextColor(WHITE);
  oled.setCursor(20, 20);
  oled.println("KIRI BOZZ");
  oled.display();
  analogWrite(IN1, 0); //motor1 A
  analogWrite(IN2, 0); //motor1 B
  analogWrite(IN3, pwm); //motor2 A
  analogWrite(IN4, 0); //motor2 B
}
void kanan_oled() {
  oled.clearDisplay();
  oled.setTextSize(2);
  oled.setTextColor(WHITE);
  oled.setCursor(5, 20);
  oled.println("KANAN BOZZ");
  oled.display();
  analogWrite(IN1, pwm); //motor1 A
  analogWrite(IN2, 0); //motor1 B
  analogWrite(IN3, 0); //motor2 A
  analogWrite(IN4, 0); //motor2 B
}
void berhenti_oled() {
  oled.clearDisplay();
  oled.setTextSize(3);
  oled.setTextColor(WHITE);
  oled.setCursor(30, 10);
  oled.println("STOP");
  oled.display();
  analogWrite(IN1, 0); //motor1 A
  analogWrite(IN2, 0); //motor1 B
  analogWrite(IN3, 0); //motor2 A
  analogWrite(IN4, 0); //motor2 B
}
void tembak_oled() {
  oled.clearDisplay();
  oled.setTextSize(5);
  oled.setTextColor(WHITE);
  oled.setCursor(30, 10);
  oled.println("BANTAIII");
  oled.display();
}

float ambilJarak(byte trigPin, byte echoPin) {
  float jarak = 0;
  unsigned long durasi = 0;
  digitalWrite(trigPin, LOW);
  delayMicroseconds(2);
  digitalWrite(trigPin, HIGH);
  delayMicroseconds(10);
  digitalWrite(trigPin, LOW);

  durasi = pulseIn(echoPin, HIGH);

  // Calculate the distance
  jarak = durasi * kecepatanSuara / 2;
  return jarak;
}

void sensor() {
  Serial.print(jarakcm1);
  Serial.print(" , ");
  Serial.print(jarakcm2);
  Serial.print(" , ");
  Serial.println(jarakcm3);
}
void setup() {
  Serial.begin(9600);
  pinMode(LS, INPUT_PULLUP);
  pinMode(trigPin1, OUTPUT);
  pinMode(echoPin1, INPUT);
  pinMode(trigPin2, OUTPUT);
  pinMode(echoPin2, INPUT);
  pinMode(trigPin3, OUTPUT);
  pinMode(echoPin3, INPUT);
  pinMode(IN1, OUTPUT);
  pinMode(IN2, OUTPUT);
  pinMode(IN3, OUTPUT);
  pinMode(IN4, OUTPUT);
  pinMode(pinRelay1, OUTPUT);
  digitalWrite(pinRelay1, LOW );
  pinMode(pinRelay2, OUTPUT);
  digitalWrite(pinRelay2, LOW );
  team();
}
void loop() {
  jarakcm1 = ambilJarak(trigPin1, echoPin1);
  jarakcm2 = ambilJarak(trigPin2, echoPin2);
  jarakcm3 = ambilJarak(trigPin3, echoPin3);

  if (kondisi == 0 && digitalRead(LS) == 0) {
    kondisi++;
    berhenti_oled();
  }
  else if (kondisi == 0 && jarakcm1 < 15 && jarakcm2 >= 15) {
    kanan_oled();
  }
  else if (kondisi == 0 && jarakcm1 >= 15 && jarakcm2 < 15) {
    kiri_oled();
  }
  else if (kondisi == 0 && jarakcm1 >= 15 && jarakcm2 >= 15) {
    maju_oled();
  }
  if (jarakcm3 < 40) {
    Serial.println("BANTAIII");
    digitalWrite(pinRelay1, 1);
    digitalWrite(pinRelay2, 1);
  }
  //Jika jarak lebih dari 50 cm maka lampu mati.
  else {
    Serial.println("AMAN");
    digitalWrite(pinRelay1, 0);
    digitalWrite(pinRelay2, 0);
  }

  DateTime waktu = rtc.now() + TimeSpan(0, 0, 0, 24);
  tahun = waktu.year();
  bulan = waktu.month();
  hari = waktu.day();
  jam = waktu.hour();
  menit = waktu.minute();
  detik = waktu.second();

  oled.setTextSize(1);
  oled.setCursor(10, 0);
  oled.print(tahun);
  oled.print('/');
  oled.print(bulan);
  oled.print('/');
  oled.print(hari);
  oled.print(' ');
  oled.print(jam);
  oled.print(':');
  oled.print(menit);
  oled.print(':');
  oled.print(detik);
  oled.display();

  // Simpan jarak sensor ke kartu microSD
  dataFile = SD.open("/sensor_data.txt", FILE_WRITE);
  if (dataFile) {
    dataFile.print(jarakcm1);
    dataFile.print(", ");
    dataFile.print(jarakcm2);
    dataFile.print(", ");
    dataFile.println(jarakcm3);
    dataFile.close();
  } else {
    Serial.println("Gagal membuka file untuk menyimpan data.");
  }

  dataFile = SD.open("/timesave_data.txt", FILE_WRITE);
  if (dataFile) {
    dataFile.print(tahun);
    dataFile.print('/');
    dataFile.print(bulan);
    dataFile.print('/');
    dataFile.println(hari);
    dataFile.print(' ');
    dataFile.print(jam);
    dataFile.print(':');
    dataFile.print(menit);
    dataFile.print(':');
    dataFile.println(detik);
    dataFile.close();
  } else {
    Serial.println("Gagal membuka file untuk menyimpan data.");
  }

}
// coco 1 test semuanya
